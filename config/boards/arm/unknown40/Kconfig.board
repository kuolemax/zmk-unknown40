## config/boards/arm/unknown40/Kconfig.board
```kconfig
# Copyright (c) 2021 Nick Winans
# SPDX-License-Identifier: MIT

config BOARD_UNKNOWN40
    bool "unknown 40"
    depends on SOC_NRF52840_QIAA
```
